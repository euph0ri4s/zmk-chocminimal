## config/boards/shields/chocminimal/Kconfig.defconfig
```kconfig
if SHIELD_CHOCMINIMAL_LEFT

config ZMK_KEYBOARD_NAME
    default "chocminimal"

config ZMK_SPLIT_ROLE_CENTRAL
    default y

endif

if SHIELD_CHOCMINIMAL_LEFT || SHIELD_CHOCMINIMAL_RIGHT

config ZMK_SPLIT
    default y

endif
```

## config/boards/shields/chocminimal/Kconfig.shield
```kconfig
config SHIELD_CHOCMINIMAL_LEFT
    def_bool $(shields_list_contains,chocminimal_left)

config SHIELD_CHOCMINIMAL_RIGHT
    def_bool $(shields_list_contains,chocminimal_right)
```
